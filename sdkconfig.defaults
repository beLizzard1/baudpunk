## sdkconfig.defaults
```kconfig
CONFIG_IDF_TARGET="esp32s3"
CONFIG_IDF_TARGET_ESP32S3=y
CONFIG_TINYUSB_ENABLED=y
CONFIG_TINYUSB_AUDIO_ENABLED=y
CONFIG_TINYUSB_AUDIO_CLASS_1=y
CONFIG_TINYUSB_AUDIO_USE_CALLBACK=y
CONFIG_TINYUSB_NET_ENABLE=y
CONFIG_TINYUSB_CDC_NCM_ENABLE=y
CONFIG_TINYUSB_DEVICE_COMPOSITE=y
CONFIG_USB_DEVICE_ENABLED=y
CONFIG_TINYUSB_MCU="OPT_MCU_ESP32S3"
CONFIG_TINYUSB_DEVICE_ENABLED=y
CONFIG_USB_OTG_SUPPORTED=y
CONFIG_USB_DEVICE_ENABLED=y
CONFIG_TINYUSB_ENABLED=y
CONFIG_IDF_CMAKE=y
CONFIG_FREERTOS_WATCHPOINT_END_OF_STACK=y
CONFIG_FREERTOS_SUPPORT_STATIC_ALLOCATION=y
CONFIG_ESP_CONSOLE_USB_SERIAL_JTAG=n
```

## sdkconfig.defaults.bak
```kconfig
CONFIG_IDF_TARGET="esp32s3"
CONFIG_TINYUSB_ENABLED=y
CONFIG_TINYUSB_AUDIO_ENABLED=y
CONFIG_TINYUSB_AUDIO_CLASS_1=y
CONFIG_TINYUSB_AUDIO_USE_CALLBACK=y
CONFIG_TINYUSB_NET_ENABLE=y
CONFIG_TINYUSB_CDC_NCM_ENABLE=y
CONFIG_TINYUSB_DEVICE_COMPOSITE=y
```
